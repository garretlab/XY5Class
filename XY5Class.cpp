#include <avr/pgmspace.h>
#include "Arduino.h"
#include "XY5Class.h"

XY5Class::XY5Class(Stream *port) : port(port) {
}

void XY5Class::begin(int displayWidth, int bufferWidth, int address) {
  this->displayWidth = displayWidth;
  this->bufferWidth = bufferWidth;
  this->address = address;
  buffer = (uint8_t *)calloc(bufferWidth, sizeof(uint8_t));
  cursor = 0;
  window = 0;
}

void XY5Class::clear() {
  for (int i = 0; i < bufferWidth; i++) {
    buffer[i] = 0;
  }
}

void XY5Class::home() {
  cursor = 0;
}

void XY5Class::scrollDisplayLeft() {
  window = (window + 1) % bufferWidth;
  flush();
}

void XY5Class::scrollDisplayRight() {
  window = (window - 1 + bufferWidth) % bufferWidth;
  flush();
}

size_t XY5Class::write(uint8_t c) {
  int offset;

  if ((cursor + XY5_FONT_WIDTH) >= bufferWidth) {  // no space available.
    return 0;
  }

  if ((0x20 <= c) && (c <= 0x60)) {        // ' ' to `
    offset = 0x20;
  } else if ((0x7b <= c) && (c <= 0x7e)) { // { to ~
    offset = 0x3a;
  } else {
    c = 0x7f;
    offset = 0x3a;
  }

  for (int i = 0; i < XY5_FONT_WIDTH; i++) {
    buffer[cursor++] = pgm_read_byte_near(fontData + XY5_FONT_WIDTH * (c - offset) + i);
  }

  cursor++;
  return 1;
}

int XY5Class::set(int x, int y) {
  buffer[x] |= 1 << y;
}

int XY5Class::unset(int x, int y) {
  buffer[x] &= ~(1 << y);
}

int XY5Class::setCursor(int x) {
  if ((0 <= x) && (x <= bufferWidth)) {
    cursor = x;
    return 1;
  } else {
    return 0;
  }
}

int XY5Class::setWindow(int x) {
  if ((0 <= x) && (x <= bufferWidth)) {
    window = x;
    return 1;
  } else {
    return 0;
  }
}

void XY5Class::flush() {
  port->write(XY5_HEADER);
  port->write(XY5_WRITE_COMMAND);
  port->write(address);

  for (int i = 0; i < 28; i++) {
    port->write(buffer[(i + window) % bufferWidth]);
  }

  port->write(XY5_ENDBYTE);
}

const uint8_t XY5Class::fontData[] PROGMEM = {
  0x00, 0x00, 0x00, 0x00, // 0x20, space
  0x00, 0x00, 0x5f, 0x00, // 0x21, !
  0x02, 0x01, 0x02, 0x01, // 0x22, "
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  0x7f, 0x7f, 0x7f, 0x7f, // out of range
};

